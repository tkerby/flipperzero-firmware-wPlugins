#include "sub_screens.h"

#include <gui/elements.h>

/* generated by fbt from .png files in images folder */
#include <ldtoypad_icons.h>

typedef struct {
    SelectionType type;
    int x, y;
    const Icon* icon_default[2];
    const Icon* icon_selected;
    const char* label;
} SelectionOption;

SelectionOption options[] = {
    {SelectionMinifigure, 6, 23, {&I_box_longer, &I_head}, &I_minifig_selected, "Minifigure"},
    {SelectionVehicle, 44, 23, {&I_box_longer, &I_car_bigger}, &I_car_bigger_selected, "Vehicle"},
    {SelectionFavorites, 82, 23, {&I_star, NULL}, &I_star_selected, "Favorites"},
    {SelectionSaved, 104, 23, {&I_save, NULL}, &I_save_selected, "Saved"},
};

void draw_placement_selection_screen(Canvas* canvas, SelectionType selection) {
    canvas_clear(canvas);
    canvas_set_font(canvas, FontPrimary);
    canvas_set_color(canvas, ColorBlack);
    canvas_draw_str(canvas, 10, 14, "Select a type to place");

    const size_t option_count = sizeof(options) / sizeof(options[0]);
    char message[15] = {0};

    // Offsets for the icons
    const int offset_x[] = {12, 5, 0, 0};
    const int offset_y[] = {2, 3, 0, 0};

    for(size_t i = 0; i < option_count; i++) {
        if(selection == options[i].type) {
            canvas_draw_icon(canvas, options[i].x, options[i].y, options[i].icon_selected);
            strcpy(message, options[i].label);
        } else {
            for(int j = 0; j < 2; j++) {
                if(options[i].icon_default[j]) {
                    int x = options[i].x + (j == 1 ? offset_x[i] : 0);
                    int y = options[i].y + (j == 1 ? offset_y[i] : 0);
                    canvas_draw_icon(canvas, x, y, options[i].icon_default[j]);
                }
            }
        }
    }

    canvas_draw_str_aligned(canvas, 64, 57, AlignCenter, AlignBottom, message);
}
